## firmware/main/Kconfig.projbuild
```kconfig
menu "Application configuration"
  config WIFI_SSID
    string "WiFi SSID"
  config WIFI_PASSWORD
    string "WiFi Password"
  config MQTT_BROKER
    string "MQTT broker"
    default "mqtt.lietar.net"
  config MQTT_USERNAME
    string "MQTT username"
  config MQTT_PASSWORD
    string "MQTT password"
  config MQTT_TOPIC_PREFIX
    string "MQTT topic prefix"
    default "calan-mai/lights"
  config RUUVI_ENABLE
    bool "Enable BLE and RuuviTag support"
  config RUUVI_MQTT_TOPIC_PREFIX
    string "MQTT topic prefix for Ruuvi tag data"
    default "calan-mai/ruuvi"
endmenu

menu "Hardware configuration"
  config HW_GPIO_PRIMARY_LED_NUM
    int "GPIO pin of LED signal"
    default 3
  config HW_GPIO_SECONDARY_LED_NUM
    int "GPIO pin of LED signal"
    default 2
  config HW_GPIO_CONTROL_NUM
    int "GPIO pin of CONTROL signal"
    default 4
  config HW_GPIO_INPUT_NUM
    int "GPIO pin of INPUT signal"
    default 5
  config HW_GPIO_STATE_NUM
    int "GPIO pin of STATE signal"
    default 7
endmenu
```

## firmware/sdkconfig.defaults
```kconfig
CONFIG_IDF_TARGET="esp32c3"
CONFIG_ESPTOOLPY_FLASHSIZE_4MB=y
CONFIG_PARTITION_TABLE_CUSTOM=y
CONFIG_WIFI_SSID="CalanMaiLegacy"
CONFIG_WIFI_PASSWORD=""
CONFIG_MQTT_USERNAME="calan-mai-gateway"
CONFIG_MQTT_PASSWORD=""
CONFIG_COMPILER_OPTIMIZATION_SIZE=y
CONFIG_MQTT_SKIP_PUBLISH_IF_DISCONNECTED=y
```
